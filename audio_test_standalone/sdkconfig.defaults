## audio_test_standalone/sdkconfig.defaults
```kconfig
# 16MB Flash + 8MB Octal PSRAM

CONFIG_IDF_TARGET="esp32s3"

CONFIG_ESPTOOLPY_FLASHSIZE_16MB=y
CONFIG_ESPTOOLPY_FLASHSIZE="16MB"
CONFIG_ESPTOOLPY_FLASHMODE_QIO=y
CONFIG_ESPTOOLPY_FLASHFREQ_80M=y

CONFIG_PARTITION_TABLE_CUSTOM=y
CONFIG_PARTITION_TABLE_CUSTOM_FILENAME="partitions.csv"
CONFIG_PARTITION_TABLE_FILENAME="partitions.csv"

CONFIG_ESP_TASK_WDT_CHECK_IDLE_TASK_CPU1=n

# PSRAM (Octal 8MB, 80MHz)
CONFIG_SPIRAM=y
CONFIG_SPIRAM_MODE_OCT=y
CONFIG_SPIRAM_TYPE_AUTO=y
CONFIG_SPIRAM_SPEED_80M=y
CONFIG_SPIRAM_BOOT_INIT=y
CONFIG_SPIRAM_USE_MALLOC=y
CONFIG_SPIRAM_ALLOW_STACK_EXTERNAL_MEMORY=y
CONFIG_SPIRAM_MALLOC_ALWAYSINTERNAL=4096
CONFIG_SPIRAM_MALLOC_RESERVE_INTERNAL=32768
CONFIG_SPIRAM_TRY_ALLOCATE_WIFI_LWIP=y
```

## lcd_demo_standalone/sdkconfig.defaults
```kconfig
# 目标芯片：ESP32-S3
CONFIG_IDF_TARGET="esp32s3"

# Flash 大小：16MB（ESP32-S3-WROOM-1-N16R8）
# 接收方板子是 N8 / N4 时，把 16MB 改成 8MB / 4MB
CONFIG_ESPTOOLPY_FLASHSIZE_16MB=y
CONFIG_ESPTOOLPY_FLASHSIZE="16MB"
CONFIG_ESPTOOLPY_FLASHMODE_QIO=y
CONFIG_ESPTOOLPY_FLASHFREQ_80M=y

# 不依赖 PSRAM（demo 全用内部 SRAM）
# 接收方板子有 PSRAM 也无影响，这里不做强制要求
```
